## .Trash-1000/files/build/conf/bblayers.conf
```bitbake
# POKY_BBLAYERS_CONF_VERSION is increased each time build/conf/bblayers.conf
# changes incompatibly
POKY_BBLAYERS_CONF_VERSION = "2"

BBPATH = "${TOPDIR}"
BBFILES ?= ""

BBLAYERS ?= " \
  /mnt/newdisk/poky/meta \
  /mnt/newdisk/poky/meta-poky \
  /mnt/newdisk/poky/meta-yocto-bsp \
  "
```

## meta-yadro2/conf/layer.conf
```bitbake
# We have a conf and classes directory, add to BBPATH
BBPATH .= ":${LAYERDIR}"

# We have recipes-* directories, add to BBFILES
BBFILES += "${LAYERDIR}/recipes-*/*/*.bb \
            ${LAYERDIR}/recipes-*/*/*.bbappend"

BBFILE_COLLECTIONS += "meta-yadro2"
BBFILE_PATTERN_meta-yadro2 = "^${LAYERDIR}/"
BBFILE_PRIORITY_meta-yadro2 = "6"

LAYERDEPENDS_meta-yadro2 = "core"
LAYERSERIES_COMPAT_meta-yadro2 = "nanbield scarthgap"
```
